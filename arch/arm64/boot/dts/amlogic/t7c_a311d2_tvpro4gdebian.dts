// SPDX-License-Identifier: (GPL-2.0+ OR MIT)
/dts-v1/;

#include "amlogic-t7-a311d2-tvpro.dts"

/ {
	model = "CoreLab A311D2-TVPro 4G";
	amlogic-dt-id = "t7c_a311d2_tvpro4g";
	compatible = "t7c_a311d2_tvpro4g", "corelab,a311d2-tvpro-4g", "corelab,a311d2-tvpro", "amlogic,a311d2", "amlogic,t7";

	memory@0 {
		reg = <0x0 0x0 0x0 0xe0000000
		       0x1 0x0 0x0 0x20000000>; /* 4 GB */
		linux,usable-memory = <0x0 0x0 0x0 0xe0000000
		                       0x1 0x0 0x0 0x20000000>;
	};
};

&cpu_ver_name {
	compatible = "amlogic, cpu-major-id-t7c";
};
