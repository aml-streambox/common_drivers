// SPDX-License-Identifier: (GPL-2.0+ OR MIT)

/dts-v1/;

#include "amlogic-t7-a311d2-tvpro.dts"

/ {
	model = "CoreLab A311D2-TVPro";
	amlogic-dt-id = "t7_a311d2_tvpro8g";
	compatible = "corelab,a311d2-tvpro", "amlogic,a311d2", "amlogic,t7";
};
